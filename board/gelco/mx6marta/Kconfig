## board/gelco/mx6marta/Kconfig
```kconfig
if TARGET_MX6MARTA

config SYS_BOARD
	default "mx6marta"

config SYS_VENDOR
	default "gelco"

config SYS_CONFIG_NAME
	default "mx6marta"

endif
```

## board/gelco/mx6qmarta/Kconfig
```kconfig
if TARGET_MX6QMARTA

config SYS_BOARD
	default "mx6qmarta"

config SYS_VENDOR
	default "gelco"

config SYS_CONFIG_NAME
	default "mx6qmarta"

endif
```
